/* Copyright (c) 2019, The Linux Foundation. All rights reserved.
 *
 * This program is free software; you can redistribute it and/or modify
 * it under the terms of the GNU General Public License version 2 and
 * only version 2 as published by the Free Software Foundation.
 *
 * This program is distributed in the hope that it will be useful,
 * but WITHOUT ANY WARRANTY; without even the implied warranty of
 * MERCHANTABILITY or FITNESS FOR A PARTICULAR PURPOSE.  See the
 * GNU General Public License for more details.
 */

&mdss_mdp {
	dsi_rm69380_edo_amoled_cmd:
		qcom,mdss_dsi_rm69380_edo_amoled_cmd {
		qcom,mdss-dsi-panel-name =
		"rm69380 amoled wqxga cmd mode dsi edo panel";
		qcom,mdss-dsi-panel-type = "dsi_cmd_mode";
		qcom,mdss-dsi-virtual-channel-id = <0>;
		qcom,mdss-dsi-stream = <0>;
		qcom,mdss-dsi-bpp = <24>;
		qcom,mdss-dsi-color-order = "rgb_swap_rgb";
		qcom,mdss-dsi-underflow-color = <0xff>;
		qcom,mdss-dsi-border-color = <0>;
		qcom,mdss-dsi-h-sync-pulse = <0>;
		qcom,mdss-dsi-traffic-mode = "non_burst_sync_event";
		qcom,mdss-dsi-lane-map = "lane_map_0123";
		qcom,mdss-dsi-bllp-eof-power-mode;
		qcom,mdss-dsi-bllp-power-mode;
		qcom,mdss-dsi-tx-eot-append;
		qcom,mdss-dsi-lane-0-state;
		qcom,mdss-dsi-lane-1-state;
		qcom,mdss-dsi-lane-2-state;
		qcom,mdss-dsi-lane-3-state;
		qcom,mdss-dsi-dma-trigger = "trigger_sw";
		qcom,mdss-dsi-mdp-trigger = "none";
		qcom,mdss-dsi-lp11-init;
		qcom,mdss-dsi-bl-pmic-control-type = "bl_ctrl_dcs";
		qcom,mdss-dsi-reset-sequence = <1 15>, <0 10>, <1 10>;
		qcom,mdss-dsi-te-pin-select = <1>;
		qcom,mdss-dsi-wr-mem-start = <0x2c>;
		qcom,mdss-dsi-wr-mem-continue = <0x3c>;
		qcom,mdss-dsi-te-dcs-command = <1>;
		qcom,mdss-dsi-te-check-enable;
		qcom,mdss-dsi-te-using-te-pin;
		qcom,mdss-dsi-display-timings {
			timing@0 {
				qcom,mdss-dsi-panel-width = <1280>;
				qcom,mdss-dsi-panel-height = <1600>;
				qcom,mdss-dsi-h-front-porch = <32>;
				qcom,mdss-dsi-h-back-porch = <38>;
				qcom,mdss-dsi-h-pulse-width = <12>;
				qcom,mdss-dsi-h-sync-skew = <0>;
				qcom,mdss-dsi-v-back-porch = <8>;
				qcom,mdss-dsi-v-front-porch = <20>;
				qcom,mdss-dsi-v-pulse-width = <4>;
				qcom,mdss-dsi-panel-framerate = <60>;
				qcom,mdss-dsi-on-command = [
                                        39 01 00 00 00 00 02 FE 62
                                        39 01 00 00 00 00 02 00 D4
                                        39 01 00 00 00 00 02 FE 60
                                        39 01 00 00 00 00 02 9E 9A
                                        39 01 00 00 00 00 02 38 D4
                                        39 01 00 00 00 00 02 FE 40
                                        39 01 00 00 00 00 02 B6 02

                                        39 01 00 00 00 00 02 FE 96
                                        39 01 00 00 00 00 02 00 00
                                        39 01 00 00 00 00 02 02 4B

                                        39 01 00 00 00 00 02 FE D0
                                        39 01 00 00 00 00 02 76 80
                                        39 01 00 00 00 00 02 FE D4
                                        39 01 00 00 00 00 02 00 80

                                        39 01 00 00 00 00 02 FE 96
                                        39 01 00 00 00 00 02 03 81
                                        39 01 00 00 00 00 02 05 D0

                                        39 01 00 00 00 00 02 FE 96
                                        39 01 00 00 00 00 02 19 26

                                        39 01 00 00 00 00 02 FE A0
                                        39 01 00 00 00 00 02 4D C4
                                        39 01 00 00 00 00 02 04 80

					39 01 00 00 00 00 02 FE 00
					39 01 00 00 00 00 02 53 28
					39 01 00 00 00 00 02 C2 08
					39 01 00 00 00 00 02 35 00
					05 01 00 00 60 00 02 11 00
					05 01 00 00 24 00 02 29 00];
				qcom,mdss-dsi-off-command = [
					05 01 00 00 23 00 02 28 00
					05 01 00 00 14 00 02 10 00];
				qcom,mdss-dsi-on-command-state = "dsi_lp_mode";
				qcom,mdss-dsi-off-command-state = "dsi_hs_mode";
			};
		};
	};
};
